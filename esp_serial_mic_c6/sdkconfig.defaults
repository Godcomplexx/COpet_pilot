## esp_serial_mic_c6/sdkconfig.defaults
```kconfig
CONFIG_IDF_TARGET="esp32c6"
# Консоль/вывод -> нативный USB (USB-Serial-JTAG). stdout идёт туда (рабочий путь).
CONFIG_ESP_CONSOLE_USB_SERIAL_JTAG=y
CONFIG_LOG_DEFAULT_LEVEL_WARN=y
CONFIG_BOOTLOADER_LOG_LEVEL_WARN=y
```

## main/Kconfig.projbuild
```kconfig
menu "CoPet Pilot"

    config COPET_WIFI_ENABLED
        bool "Enable Wi-Fi Station"
        default y
        help
            Start Wi-Fi in the background while local Desk Mode keeps running.

    config COPET_WIFI_SSID
        string "Wi-Fi SSID"
        default ""
        depends on COPET_WIFI_ENABLED
        help
            Stored only in the local sdkconfig file, which is ignored by Git.

    config COPET_WIFI_PASSWORD
        string "Wi-Fi password"
        default ""
        depends on COPET_WIFI_ENABLED
        help
            Stored only in the local sdkconfig file. Never print it to logs.

    config COPET_WIFI_SSID_2
        string "Wi-Fi SSID (2nd network, optional)"
        default ""
        depends on COPET_WIFI_ENABLED
        help
            Optional second known network. When two or more networks are set,
            the device scans the air on boot and reconnect and joins the
            highest-priority known network in range, so it works at more than
            one location without reflashing. Leave empty to disable.

    config COPET_WIFI_PASSWORD_2
        string "Wi-Fi password (2nd network)"
        default ""
        depends on COPET_WIFI_ENABLED
        help
            Password for the 2nd network. Local sdkconfig only; never logged.

    config COPET_WIFI_SSID_3
        string "Wi-Fi SSID (3rd network, optional)"
        default ""
        depends on COPET_WIFI_ENABLED
        help
            Optional third known network. Leave empty to disable.

    config COPET_WIFI_PASSWORD_3
        string "Wi-Fi password (3rd network)"
        default ""
        depends on COPET_WIFI_ENABLED
        help
            Password for the 3rd network. Local sdkconfig only; never logged.

    config COPET_MIC_ENABLED
        bool "Enable microphone listening reaction"
        default y
        help
            Capture ambient loudness from the INMP441 on the shared I2S bus and
            show the "listening" emotion when there is sustained sound (music)
            around. Best-effort: if the mic fails to start, event sounds still
            work. Turn off to run the speaker only.

    config COPET_MUSIC_DEBUG
        bool "Log microphone music-detector features"
        default y
        depends on COPET_MIC_ENABLED
        help
            Print level / ZCR / melodicity score once per second to the serial
            log. Use it to watch the detector while playing music and tune the
            thresholds in music_detector.h, then turn it off for normal use.

    config COPET_DIAGNOSTIC_BLE_ENABLED
        bool "Enable optional diagnostic BLE at boot"
        default n
        help
            BLE is not required for normal phone-free operation. Keeping it off
            leaves more RAM for network services on ESP32-WROOM-32.

    config COPET_WEATHER_ENABLED
        bool "Enable outdoor weather"
        default y
        depends on COPET_WIFI_ENABLED

    config COPET_WEATHER_LATITUDE
        string "Weather latitude"
        default "53.1959"
        depends on COPET_WEATHER_ENABLED
        help
            WGS84 latitude. Default is Samara.

    config COPET_WEATHER_LONGITUDE
        string "Weather longitude"
        default "50.1008"
        depends on COPET_WEATHER_ENABLED
        help
            WGS84 longitude. Default is Samara.

    config COPET_TIMEZONE
        string "Local timezone (POSIX TZ)"
        default "<+04>-4"
        help
            POSIX TZ string for the clock the assistant reads after SNTP sync.
            Default "<+04>-4" is Samara time (UTC+4, no DST). Note the POSIX
            sign is inverted: the "-4" means UTC+4. Examples: Moscow "MSK-3",
            UTC "UTC0".

    config COPET_ASSISTANT_ENABLED
        bool "Enable Assistant Mode"
        default y
        help
            Show the Assistant screen in the menu and start its background
            service. See docs/27_assistant_m7_plan.md.

    choice COPET_ASSISTANT_BACKEND
        prompt "Assistant backend"
        depends on COPET_ASSISTANT_ENABLED
        default COPET_ASSISTANT_BACKEND_STUB
        help
            Where assistant answers come from. The stub returns canned/local
            answers with no network; HTTP calls a real CoPet Cloud endpoint.

        config COPET_ASSISTANT_BACKEND_STUB
            bool "Local stub (canned answers, no network)"

        config COPET_ASSISTANT_BACKEND_HTTP
            bool "HTTP /v1/query (real cloud API)"
    endchoice

    config COPET_ASSISTANT_ENDPOINT
        string "Assistant API base URL"
        depends on COPET_ASSISTANT_BACKEND_HTTP
        default ""
        help
            Base URL of the CoPet Cloud API, e.g. https://your-host. The device
            POSTs to <base>/v1/query per docs/architecture/cloud_api_contract.md.
            No secret key is stored on the device; the backend holds provider
            keys. Leave empty to fall back to the stub.

endmenu
```

## sdkconfig.defaults
```kconfig
CONFIG_FREERTOS_HZ=1000
CONFIG_ESP_MAIN_TASK_STACK_SIZE=4096
CONFIG_LOG_DEFAULT_LEVEL_INFO=y
CONFIG_BT_ENABLED=y
CONFIG_BTDM_CTRL_MODE_BLE_ONLY=y
CONFIG_BTDM_CTRL_MODE_BR_EDR_ONLY=n
CONFIG_BTDM_CTRL_MODE_BTDM=n
CONFIG_BT_BLUEDROID_ENABLED=n
CONFIG_BT_NIMBLE_ENABLED=y
# CoPet uses Wi-Fi for small API requests, so keeping Wi-Fi routines in scarce
# ESP32-WROOM IRAM is unnecessary. Disabling these options lets Wi-Fi and BLE
# coexist in the same firmware image.
CONFIG_ESP_WIFI_IRAM_OPT=n
CONFIG_ESP_WIFI_RX_IRAM_OPT=n
# Wi-Fi + BLE is larger than the default 1 MB factory partition.
CONFIG_PARTITION_TABLE_SINGLE_APP=n
CONFIG_PARTITION_TABLE_SINGLE_APP_LARGE=y
```
